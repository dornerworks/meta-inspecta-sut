## meta-common-vm/conf/layer.conf
```bitbake
# We have a conf and classes directory, add to BBPATH
BBPATH .= ":${LAYERDIR}"

# We have recipes-* directories, add to BBFILES
BBFILES += "${LAYERDIR}/recipes-*/*/*.bb \
            ${LAYERDIR}/recipes-*/*/*.bbappend"

BBFILE_COLLECTIONS += "meta-common-vm"
BBFILE_PATTERN_meta-common-vm = "^${LAYERDIR}/"
BBFILE_PRIORITY_meta-common-vm = "10"

LAYERDEPENDS_meta-common-vm = "core"
LAYERSERIES_COMPAT_meta-common-vm = "gatesgarth"
```

## meta-docker-vm/conf/layer.conf
```bitbake
# We have a conf and classes directory, add to BBPATH
BBPATH .= ":${LAYERDIR}"

# We have recipes-* directories, add to BBFILES
BBFILES += "${LAYERDIR}/recipes-*/*/*.bb \
            ${LAYERDIR}/recipes-*/*/*.bbappend"

BBFILE_COLLECTIONS += "meta-default-docker-vm"
BBFILE_PATTERN_meta-default-docker-vm = "^${LAYERDIR}/"
BBFILE_PRIORITY_meta-default-docker-vm = "10"

LAYERDEPENDS_meta-default-docker-vm = "core"
LAYERSERIES_COMPAT_meta-default-docker-vm = "gatesgarth"
```
